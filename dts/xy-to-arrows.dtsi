#pragma once

/ {
    /omit-if-no-ref/ zip_xy_to_arrows: zip_xy_to_arrows {
        compatible = "zmk,input-processor-xy-to-arrows";
        #input-processor-cells = <0>;
        threshold = <36>;
        idle-reset-ms = <150>;
    };
};
