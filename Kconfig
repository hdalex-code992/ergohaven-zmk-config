## Kconfig
```kconfig
config ZMK_INPUT_PROCESSOR_XY_TO_ARROWS
	bool "XY to 4-way Arrow Keys Input Processor"
	default y
	depends on ZMK_POINTING
	help
	  Convert relative X/Y trackball motion into 4-way dominant-axis arrow key taps.

config ZMK_TB_SPEED_CONTROL
	bool "Persistent 5-Preset Trackball Scroll & Text Speed Controller"
	default y
	depends on ZMK_POINTING
	select SETTINGS
	help
	  Persistent 5-preset speed scaler for smooth 2D scroll and 4-way text arrows.
```

## dts/bindings/behaviors/zmk,behavior-tb-speed.yaml
```yaml
description: Trackball 5-preset speed step / hold-reset behavior

compatible: "zmk,behavior-tb-speed"

properties:
  "#binding-cells":
    type: int
    const: 0
    description: "Zero runtime binding parameters"

  display-name:
    type: string
    description: "Human-readable name for ZMK Studio"

  direction:
    type: int
    required: true
    description: "Step direction (+1 for faster, -1 for slower)"

  hold-reset-ms:
    type: int
    default: 800
    description: "Hold duration in ms to reset speed to Preset 3 (default)"
```

## dts/bindings/input-processors/zmk,input-processor-tb-scroll-scaler.yaml
```yaml
description: Dynamic 5-preset smooth scroll speed scaler input processor

compatible: "zmk,input-processor-tb-scroll-scaler"

properties:
  "#input-processor-cells":
    type: int
    const: 0
    description: "Number of cells in input processor specifier"

  idle-reset-ms:
    type: int
    default: 200
    description: "Reset fractional remainders after idle timeout in ms"
```

## dts/bindings/input-processors/zmk,input-processor-xy-to-arrows.yaml
```yaml
description: XY relative motion to 4-way arrow key taps input processor

compatible: "zmk,input-processor-xy-to-arrows"

properties:
  "#input-processor-cells":
    type: int
    const: 0
    description: "Number of cells in input processor specifier"

  threshold:
    type: int
    default: 36
    description: "Accumulated counts required per arrow tap"

  idle-reset-ms:
    type: int
    default: 150
    description: "Reset accumulators after idle timeout in ms"

  track-remainders:
    type: boolean
    description: "Whether ZMK input listener tracks remainders for this processor"
```
